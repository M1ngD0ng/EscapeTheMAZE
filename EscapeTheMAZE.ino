#define DIRC (*((volatile unsigned char*)0x0440))
#define INC (*((volatile unsigned char*)0x0448))
#define DIRD (*((volatile unsigned char*)0x0460))
#define RXDATAL (*((volatile unsigned char*)0x0820))
#define RXDATAH (*((volatile unsigned char*)0x0821))
#define TXDATAL (*((volatile unsigned char*)0x0822))
#define TXDATAH (*((volatile unsigned char*)0x0823))
#define STATUS (*((volatile unsigned char*)0x0824))
#define U_CTRLA (*((volatile unsigned char*)0x0825))
#define U_CTRLB (*((volatile unsigned char*)0x0826))
#define U_CTRLC (*((volatile unsigned char*)0x0827))
#define BAUD (*((volatile uint16_t*)0x0828))
//#define BAUDL (*((volatile uint16_t*)0x0828))
//#define BAUDH (*((volatile uint16_t*)0x0829))
#define CTRLA (*((volatile unsigned char*)0x0600))
#define CTRLC (*((volatile unsigned char*)0x0602)) // REFSEL 01
#define MUXPOS (*((volatile unsigned char*)0x0606))
#define COMMAND (*((volatile unsigned char*)0x0608))
#define EVCTRL (*((volatile unsigned char*)0x0609))
#define RES (*((volatile uint16_t*)0x0610))
#define INTCTRL (*((volatile unsigned char*)0x060A))
#define INTFLAGS (*((volatile unsigned char*)0x060B))


#define F_CPU 16000000

#define USART1_BAUD_RATE(BAUD_RATE) ((float)(F_CPU * 20 / (30 * (float)BAUD_RATE)) + 0.5)

// STATUS 레지스터
#define RXCIF 7
#define TXCIF 6
#define DREIF 5
#define RXSIF 4

// CTRLB 레지스터
#define RXEN 7
#define TXEN 6

#define TXD1 (0x01)
#define RXD1 (0x02)
#define PIN5 (0x20)

static uint8_t player[]  =
{
  /* 00000000 */ 0x00,
  /* 01111110 */ 0x7e,
  /* 01111110 */ 0x7e,
  /* 01111110 */ 0x7e,
  /* 01111110 */ 0x7e,
  /* 01111110 */ 0x7e,
  /* 01111110 */ 0x7e,
  /* 00000000 */ 0x00
};

uint16_t exX, exY;
uint16_t inX, inY;
uint16_t posX = 4;
uint16_t posY = 12;
int newWALL_CNT = 0;

void TX(unsigned char data) {
  while (!(STATUS & (1 << DREIF)));
  TXDATAL = data;
}
void TX_str(char *str) {
  for (int i = 0; str[i]; i++) TX(str[i]);
}
uint16_t x_i_to_str(int n, char *buf) {
  uint16_t rt;
  sprintf(buf, "%04d", n);
  buf[4] = '\0';
  TX_str(buf);
  TX_str("\n");

  rt = atoi(buf);
  return rt;
}
uint16_t y_i_to_str(int n, char *buf) {
  uint16_t rt;
  sprintf(buf, "%04d", n);
  buf[4] = '\0';
  TX_str(buf);
  TX_str("\n");

  rt = atoi(buf);
  return rt;
}

unsigned char RX(void) {
  while (!(STATUS & (1 << RXCIF)));
  return RXDATAL;
}
int get_value() {
  COMMAND = (1 << 0); // Start Conversion
  while (!(INTFLAGS & (1 << 0)));
  return RES;
}
int get_value_sw() {

  if ((INC & 0x20) == 0x20) { //눌렀을때
    __delay_us(100);
    TX('0');
    return 0;
  }
  else { //뗐을때
    __delay_us(100);
    TX('1');
    return 1;
  }
}
void adc_init(void) {
  BAUD = (uint16_t)USART1_BAUD_RATE(9600);
  U_CTRLB |= (1 << RXEN) | (1 << TXEN);
  DIRC &= ~RXD1;
  DIRC |= TXD1; //UART 설정
  DIRC &= ~PIN5;
  DIRD &= 0x00; //조이스틱 설정
  INC = 0x20;

  CTRLA |= (0 << 2) | (1 << 1) | (1 << 0);
  //  해상도 10bit, freerun, ADC enable
  CTRLC |= (0 << 5) | (1 << 4) | (1 << 2) | (0 << 1) | (1 << 0);
  //  RefSel(2bits), Prescaler(3bits 128)

  INTCTRL = (1 << 0); // interrupt enable
}
//////////////////////// 위에는 조이스틱, 아래는 OLED ////////

#define TWI0 (*((volatile unsigned char*)0x08A0))
#define MCTRLA (*((volatile unsigned char*)0x08A3))
#define MCTRLB (*((volatile unsigned char*)0x08A4))
#define MSTATUS (*((volatile unsigned char*)0x08A5))
#define MBAUD (*((volatile unsigned char*)0x08A6))
#define MADDR (*((volatile unsigned char*)0x08A7))
#define MDATA (*((volatile unsigned char*)0x08A8))
// #define RTC (*((volatile unsigned char*)0x0140))
// #define PITINTFLAGS (*((volatile unsigned char*)0x0153))

#define SCLCTRL (*((volatile unsigned char*)0x0412))
#define SDACTRL (*((volatile unsigned char*)0x0411))

#define PORTMUX (*((volatile unsigned char*)0x05E0))
#define DIRA (*((volatile unsigned char*)0x0400))
#define OUTA (*((volatile unsigned char*)0x0404))
#define INA (*((volatile unsigned char*)0x0408))
#define DIRC (*((volatile unsigned char*)0x0440))
#define DIRD (*((volatile unsigned char*)0x0460))

#define F_CPU 16000000
#define TWI0_BAUD(F_SCL, T_RISE) (((float)16000000.0/(float)F_SCL)-10-((float)16000000.0*T_RISE/100000))/2

// OLED
#define RESET (0x10)
#define SCL (0x08)
#define SDA (0x04)

// MSTATUS
#define RIF (0x80)
#define WIF (0x40)
#define RXACK (0x10)

// TWI pin
#define TWI_ENABLE_bp 0
#define TWI_QCEN_bp 4
#define TWI_RIEN_bp 7
#define TWI_SMEN_bp 1
#define TWI_TIMEOUT_DISABLED_gc (0x00<<2)
#define TWI_WIEN_bp 6
#define TWI_BUSSTATE_IDLE_gc (0x01<<0)
#define TWI_RIF_bm (0x80)
#define TWI_WIF_bm (0x40)
#define TWI_BUSERR_bm (0x04)
#define TWI_FLUSH_bm (0x04)
#define TWI_MCMD_STOP_gc (0x03<<0)
#define TWI_ACKACT_NACK_gc (0x01<<2)
#define TWI_RXACK_bm (0x10)
#define TWI_MCMD_RECVTRANS_gc (0x02<<0)
#define PORT_INVEN_bm (0x80)
#define PORT_ISC_gm (0x07)
#define PORT_ISC_INTDISABLE_gc (0x00<<0)
#define PORT_PULLUPEN_bm (0x08)
#define TWI_ARBLOST_bm (0x08)
#define TWI_RXACK_bm (0x10)
#define TWI_BUSSTATE_gm (0x03)
#define TWI_BUSSTATE_OWNER_gc (0x02<<0)
#define TWI_ACKACT_bp 2
#define RTC_PI_bm (0x01)

static unsigned char wall_1[] =  {
  0xFF, 0xFF, 0xFF, 0xFF, 0xFF, 0xFF, 0xFF, 0xFF, 0xFF, 0xFF, 0xFF, 0xFF, 0xFF, 0xFF, 0xFF, 0xFF,
  0xFF, 0xFF, 0xFF, 0xFF, 0xFF, 0xFF, 0xFF, 0xFF, 0xFF, 0xFF, 0xFF, 0xFF, 0xFF, 0xFF, 0xFF, 0xFF,
  0xFF, 0xFF, 0xFF, 0xFF, 0xFF, 0xFF, 0xFF, 0xFF, 0xFF, 0xFF, 0xFF, 0xFF, 0xFF, 0xFF, 0xFF, 0xFF,
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  0xFF, 0xFF, 0xFF, 0xFF, 0xFF, 0xFF, 0xFF, 0xFF, 0xFF, 0xFF, 0xFF, 0xFF, 0xFF, 0xFF, 0xFF, 0xFF
};



static unsigned char wall_2[] = {
  0xFF, 0xFF, 0xFF, 0xFF, 0xFF, 0xFF, 0xFF, 0xFF, 0xFF, 0xFF, 0xFF, 0xFF, 0xFF, 0xFF, 0xFF, 0xFF,
  0xFF, 0xFF, 0xFF, 0xFF, 0xFF, 0xFF, 0xFF, 0xFF, 0xFF, 0xFF, 0xFF, 0xFF, 0xFF, 0xFF, 0xFF, 0xFF,
  0xFF, 0xFF, 0xFF, 0xFF, 0xFF, 0xFF, 0xFF, 0xFF, 0xFF, 0xFF, 0xFF, 0xFF, 0xFF, 0xFF, 0xFF, 0xFF,
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  0xFF, 0xFF, 0xFF, 0xFF, 0xFF, 0xFF, 0xFF, 0xFF, 0xFF, 0xFF, 0xFF, 0xFF, 0xFF, 0xFF, 0xFF, 0xFF
};

static unsigned char img_main[] = {
  0x00, 0x00, 0x00, 0x00, 0x00, 0x00, 0x00, 0x00, 0x00, 0x00, 0x00, 0x00, 0x00, 0x00, 0x00, 0x00,
  0x00, 0x00, 0x00, 0x00, 0x00, 0x00, 0x00, 0x00, 0x00, 0x00, 0x00, 0x00, 0x00, 0x00, 0x00, 0x00,
  0x00, 0x00, 0x00, 0x00, 0x00, 0x00, 0x00, 0x00, 0x00, 0x00, 0x00, 0x00, 0x00, 0x00, 0x00, 0x00,
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  0x00, 0x00, 0x00, 0x00, 0x00, 0x00, 0x00, 0x00, 0x00, 0x00, 0x00, 0x00, 0x00, 0x00, 0x00, 0x00
};

static uint8_t wall[8][128];

void __delay_us(unsigned int value) {
  unsigned int i;
  for (i = 0; i < value * 2; i++) {
    asm(" NOP ");
    asm(" NOP ");
    asm(" NOP ");
  }
}
void __delay_ms(unsigned int value) {
  unsigned int i;
  for (i = 0; i < value; i++) {
    __delay_us(666);
  }
}

/*============================================================================*/


#define SSD1306_I2C_ADDR    0x3c
#define SSD1306_I2C_CMD     0x00
#define SSD1306_I2C_DATA    0x40
/*============================================================================*/
/* Fundamental Command */
#define SSD1306_CMD_ENTIRE_ON           0xA5
#define SSD1306_CMD_OUTPUT_RAM_DISPLAY  0xA4
#define SSD1306_CMD_DISPLAY_ON          0xAF
#define SSD1306_CMD_DISPLAY_OFF         0xAE

#define SSD1306_CMD_MUX_RATIO           0xA8
#define SSD1306_CMD_DISPLAY_OFFSET      0xD3
#define SSD1306_CMD_DISPLAY_START_LINE  0x40
#define SSD1306_CMD_COM_PIN             0xDA
#define SSD1306_CMD_CONTRAST_CONTROL    0x81

/* Addressing Setting Command */
#define SSD1306_CMD_ADDR_MODE           0x20
#define SSD1306_CMD_COL_ADDR            0x21
#define SSD1306_CMD_ROW_ADDR            0x22

#define SSD1306_CMD_CHARGEPUMP          0x8D
#define SSD1306_CMD_NORMAL_DISPLAY      0xA6

#define SSD1306_CMD_COL_LO_ADDR         0x00
#define SSD1306_CMD_COL_HI_ADDR         0x10
#define SSD1306_CMD_PAGE_START_ADDR     0xB0
#define SSD1306_CMD_OSC_FREQUENCY       0xD5
#define SSD1306_SEGREMAP                0xA1

#define SSD1306_COMSCANDEC              0xC8
#define SSD1306_SETPRECHARGE            0xD9
#define SSD1306_SETVCOMDETECT           0xDB

#define SSD1306_DEACTIVATE_SCROLL       0x2E


#define SSD1306_SETCONTRAST 0x81
#define SSD1306_DISPLAYALLON_RESUME 0xA4
#define SSD1306_DISPLAYALLON 0xA5
#define SSD1306_NORMALDISPLAY 0xA6
#define SSD1306_INVERTDISPLAY 0xA7
#define SSD1306_DISPLAYOFF 0xAE
#define SSD1306_DISPLAYON 0xAF

#define SSD1306_SETDISPLAYOFFSET 0xD3
#define SSD1306_SETCOMPINS 0xDA

#define SSD1306_SETVCOMDETECT 0xDB

#define SSD1306_SETDISPLAYCLOCKDIV 0xD5
#define SSD1306_SETPRECHARGE 0xD9

#define SSD1306_SETMULTIPLEX 0xA8

#define SSD1306_SETLOWCOLUMN 0x00
#define SSD1306_SETHIGHCOLUMN 0x10

#define SSD1306_SETSTARTLINE 0x40

#define SSD1306_MEMORYMODE 0x20
#define SSD1306_COLUMNADDR 0x21
#define SSD1306_PAGEADDR   0x22

#define SSD1306_COMSCANINC 0xC0
#define SSD1306_COMSCANDEC 0xC8


#define SSD1306_CHARGEPUMP 0x8D

#define SSD1306_EXTERNALVCC 0x1
#define SSD1306_SWITCHCAPVCC 0x2

// Scrolling #defines
#define SSD1306_ACTIVATE_SCROLL 0x2F
#define SSD1306_DEACTIVATE_SCROLL 0x2E
#define SSD1306_SET_VERTICAL_SCROLL_AREA 0xA3
#define SSD1306_RIGHT_HORIZONTAL_SCROLL 0x26
#define SSD1306_LEFT_HORIZONTAL_SCROLL 0x27
#define SSD1306_VERTICAL_AND_RIGHT_HORIZONTAL_SCROLL 0x29
#define SSD1306_VERTICAL_AND_LEFT_HORIZONTAL_SCROLL 0x2A

#define pgm_read_byte(addr) (*(const unsigned char *)(addr))
#define ssd1306_swap(a, b) { int t = a; a = b; b = t; }
#define rotation 0


#define WIDTH 128
#define HEIGHT 64

#define PAGE_NUM        8
#define COL_NUM         128
#define CHAR_WIDTH      6
#define MAX_CH_PER_LINE 21


static uint8_t gddram[1024];
uint8_t gddram_dot[PAGE_NUM][COL_NUM];

typedef int bool;
enum
{
  HORIZONTAL,
  VERTICAL,
  PAGE
};

uint8_t TWI_start(uint8_t dev_addr) {
  MSTATUS |= (TWI_RIF_bm | TWI_WIF_bm);
  if (MSTATUS & TWI_BUSERR_bm) return 4;
  MADDR = dev_addr;
  return 0;
}
uint8_t TWI_wait_ACK() {
  while (!(MSTATUS & TWI_RIF_bm) && !(MSTATUS & TWI_WIF_bm));
  MSTATUS |= (TWI_RIF_bm | TWI_WIF_bm);
  if (MSTATUS & TWI_BUSERR_bm) return 4;
  if (MSTATUS & TWI_ARBLOST_bm) return 2;
  if (MSTATUS & TWI_RXACK_bm) return 1;
  return 0;
}
uint8_t TWI_write_byte(uint8_t dev_addr, uint8_t reg_addr, uint8_t *data, int len) {
  uint8_t stat;
  stat = TWI_start(dev_addr << 1);
  //////
  stat = TWI_wait_ACK();                    // wait for Slave ACK
  if (stat == 1) {
    TWI_stop();                         // NACK, abort
    return 1;
  }
  stat = TWI_write(&reg_addr);
  stat = TWI_wait_ACK();
  while (len > 0) {                     // write bytes
    stat = TWI_write(data);
    data++;
    len--;
  }
  TWI_stop();
  return 0;
}

uint8_t TWI_write(uint8_t *data) {
  if ((MSTATUS & TWI_BUSSTATE_gm) == TWI_BUSSTATE_OWNER_gc) {
    MDATA = *data;
  }
}
uint8_t TWI_init() {

  DIRA = SDA;
  MBAUD = (uint8_t) TWI0_BAUD(100000, 0);          // set MBAUD register, TWI0_BAUD macro calculates parameter for 100 kHz
  MCTRLB = TWI_FLUSH_bm;                   // clear the internal state of the master
  MCTRLA =   1 << TWI_ENABLE_bp;               // Write Interrupt Enable: disabled
  DIRA |= SCL;             // set port output direction for SCL low signal level
  MSTATUS |= TWI_BUSSTATE_IDLE_gc;             // force bus idle
  MSTATUS |= (TWI_RIF_bm | TWI_WIF_bm | TWI_BUSERR_bm);    // clear flags

}
void TWI_stop()
{
  MCTRLB |= TWI_MCMD_STOP_gc;
}

static inline void RES_high(void) {
  OUTA |= RESET;
}
static inline void RES_low(void) {
  OUTA &= ~RESET;
}
void ssd1306_reset(void)
{
  DIRA = RESET;
  RES_low();
  __delay_ms(1);
  RES_high();
}
void setXY(unsigned char row, unsigned char col)
{
  uint8_t cmd_page = (0xb0 + row);
  uint8_t cmd_lowcol = (0x00 + (8 * col & 0x0f));
  uint8_t cmd_highcol = (0x10 + ((8 * col >> 4) & 0x0f));

  ssd1306_cmd(&cmd_page, 1);             //set page address
  ssd1306_cmd(&cmd_lowcol, 1); //set low col address
  ssd1306_cmd(&cmd_highcol, 1); //set high col address
}
void ssd1306_cmd(uint8_t *cmd, uint8_t len)
{
  TWI_write_byte(SSD1306_I2C_ADDR, SSD1306_I2C_CMD, cmd, len);
}

void ssd1306_data(uint8_t *data, uint16_t len)
{
  TWI_write_byte(SSD1306_I2C_ADDR, SSD1306_I2C_DATA, data, len);
}
static void ssd1306_chargepump_enable(bool enable)
{
  uint8_t     cmd_buf[2];

  cmd_buf[0] = SSD1306_CMD_CHARGEPUMP;
  cmd_buf[1] = 0x10 | (enable ? 4 : 0);

  ssd1306_cmd(cmd_buf, 2);
}

static void ssd1306_entire_on(bool enable)
{
  uint8_t     cmd = SSD1306_CMD_ENTIRE_ON | enable;

  ssd1306_cmd(&cmd, 1);
}

static void ssd1306_display_on(bool enable)
{
  uint8_t     cmd = SSD1306_CMD_DISPLAY_ON | enable;

  ssd1306_cmd(&cmd, 1);
}
static void ssd1306_display_off(bool enable)
{
  uint8_t     cmd = SSD1306_CMD_DISPLAY_OFF | enable;

  ssd1306_cmd(&cmd, 1);
}
static void ssd1306_set_addr_mode(uint8_t mode)
{
  uint8_t     cmd_buf[2];

  cmd_buf[0] = SSD1306_CMD_ADDR_MODE;
  cmd_buf[1] = mode;

  ssd1306_cmd(cmd_buf, 2);
}
static void ssd1306_set_page_start(uint8_t page)
{
  uint8_t     cmd = SSD1306_CMD_PAGE_START_ADDR + page;

  ssd1306_cmd(&cmd, 1);
}
static void ssd1306_set_column_addr(uint8_t column)
{
  uint8_t     cmd;

  cmd = SSD1306_CMD_COL_LO_ADDR + (8 * column & 0x0F);
  ssd1306_cmd(&cmd, 1);

  cmd = SSD1306_CMD_COL_HI_ADDR + ((8 * column >> 4) & 0x0F);
  ssd1306_cmd(&cmd, 1);
}
static void set_start_end_col(uint8_t start_col, uint8_t end_col) {
  uint8_t cmd_buf[3];

  cmd_buf[0] = SSD1306_CMD_COL_ADDR;
  cmd_buf[1] = start_col;
  cmd_buf[2] = end_col;

  ssd1306_cmd(cmd_buf, 3);
}
static void set_start_end_row(uint8_t start_row, uint8_t end_row) {
  uint8_t cmd_buf[3];

  cmd_buf[0] = SSD1306_CMD_ROW_ADDR;
  cmd_buf[1] = start_row;
  cmd_buf[2] = end_row;

  ssd1306_cmd(cmd_buf, 3);
}
static void ssd1306_normal_display(bool enable)
{
  uint8_t     cmd = SSD1306_CMD_NORMAL_DISPLAY | enable;

  ssd1306_cmd(&cmd, 1);
}
static void ssd1306_set_Mux_ratio(uint8_t mux)
{
  uint8_t     cmd_buf[2];

  cmd_buf[0] = SSD1306_CMD_MUX_RATIO;
  cmd_buf[1] = mux;

  ssd1306_cmd(cmd_buf, 2);
}
static void ssd1306_set_Display_Offset(uint8_t com)
{
  uint8_t     cmd_buf[2];

  cmd_buf[0] = SSD1306_CMD_DISPLAY_OFFSET;
  cmd_buf[1] = com;

  ssd1306_cmd(cmd_buf, 2);
}
static void ssd1306_set_COM_pin(uint8_t pin)
{
  uint8_t     cmd_buf[2];

  cmd_buf[0] = SSD1306_CMD_COM_PIN;
  cmd_buf[1] = pin;

  ssd1306_cmd(cmd_buf, 2);
}
static void ssd1306_set_Osc_Frequency(uint8_t val)
{
  uint8_t     cmd_buf[2];

  cmd_buf[0] = SSD1306_CMD_OSC_FREQUENCY;
  cmd_buf[1] = val;

  ssd1306_cmd(cmd_buf, 2);
}
static void ssd1306_set_Pre_Charge(uint8_t val)
{
  uint8_t     cmd_buf[2];

  cmd_buf[0] = SSD1306_SETPRECHARGE;
  cmd_buf[1] = val;

  ssd1306_cmd(cmd_buf, 2);
}
static void ssd1306_set_Contrast_control(uint8_t val)
{
  uint8_t     cmd_buf[2];

  cmd_buf[0] = SSD1306_CMD_CONTRAST_CONTROL;
  cmd_buf[1] = val;

  ssd1306_cmd(cmd_buf, 2);
}
static void ssd1306_set_VCOM_Detect(uint8_t val)
{
  uint8_t     cmd_buf[2];

  cmd_buf[0] = SSD1306_SETVCOMDETECT;
  cmd_buf[1] = val;

  ssd1306_cmd(cmd_buf, 2);
}

void clear_screen(void)
{
  uint8_t page;
  uint8_t col, k;

  for (page = 0; page < PAGE_NUM; page++)
    for (col = 0; col < COL_NUM; col++)
      gddram_dot[page][col] = 0;

  for (page = 0; page < PAGE_NUM; page++)
  {
    ssd1306_set_page_start(page);
    //ssd1306_data(gddram, COL_NUM);
    for (col = 0; col < COL_NUM; col++)
    {
      ssd1306_data(&gddram_dot[page][col], 1);
    }
  }

}
void draw_dot(uint8_t val, uint8_t row, uint8_t col)
{
  uint8_t page = row >> 3;
  uint8_t *dot = &gddram_dot[page][col];

  if (val)
    *dot |= 1 << (row & 7);
  else
    *dot &= ~(1 << (row & 7));
  ssd1306_set_page_start(page);
  ssd1306_set_column_addr(col);
  ssd1306_data(dot, 1);
}
void drawBitMap(int16_t x, int16_t y, const uint8_t *bitmap, int16_t w, int16_t h, uint16_t color) {
  int16_t i, j, byteWidth;

  byteWidth = (w + 7) / 8;

  for (j = 0; j < h; j++) {
    for (i = 0; i < w; i++) {
      if (bitmap[j * byteWidth + i / 8] & (128 >> (i & 7))) {
        SSD1306_drawPixel(x + i, y + j, color);
      }
    }
  }
}
void clear_screen_gddram(void) { // gddram 클리어
  int i;
  for (i = 0; i < COL_NUM * PAGE_NUM; i++)
    gddram[i] = 0;

  displayOLEDFlush();
}
void pattern1(uint8_t dot) {
  uint8_t row;
  uint8_t col;

  for (row = 0; row < PAGE_NUM * 8; row++)
    for (col = 0; col < COL_NUM; col++) {
      draw_dot(dot, row, col);
      __delay_us(1);
    }
}
void pattern2(void) {
  static int loop = 0;
  pattern1(++loop & 1);
}
void displayOLEDFlush(void) { //gddram 일괄전송
  ssd1306_set_addr_mode(HORIZONTAL);
  ssd1306_set_page_start(0);

  for (int i = 0; i < 1024; i++)
  {
    ssd1306_data(&gddram[i], 1);
    __delay_us(10);
  }

  ssd1306_set_column_addr(0);
}
void SSD1306_drawPixel(int16_t x, int16_t y, uint16_t color) {

  switch (color) {
    case 0://white
      gddram[x + (y / 8) * 128] |= (1 << (y & 7));
      break;
    case 1://black
      gddram[x + (y / 8) * 128] &= ~(1 << (y & 7));
      break;
    case 2://inverse
      gddram[x + (y / 8) * 128] ^= (1 << (y & 7));
      break;
  }
}

void drawline(int16_t x0, int16_t y0, int16_t x1, int16_t y1, uint16_t color) {
  int16_t steep = abs(y1 - y0) > abs(x1 - x0);

  if (steep) {
    ssd1306_swap(x0, y0);
    ssd1306_swap(x1, y1);
  }
  if (x0 > x1) {
    ssd1306_swap(x0, x1);
    ssd1306_swap(y0, y1);
  }
  int16_t dx, dy;
  dx = x1 - x0;
  dy = abs(y1 - y0);

  int16_t err = dx / 2;
  int16_t ystep;

  if (y0 < y1) {
    ystep = 1;
  } else {
    ystep = -1;
  }

  for (; x0 <= x1; x0++) {
    if (steep) {
      SSD1306_drawPixel(y0, x0, color);
    } else {
      SSD1306_drawPixel(x0, y0, color);
    }
  }

  err -= dy;

  if (err < 0) {
    y0 += ystep;
    err += dx;
  }
}

void drawCicle(int16_t x0, int16_t y0, int16_t r, uint16_t color) {
  int16_t f = 1 - r;
  int16_t ddF_x = 1;
  int16_t ddF_y = -2 * r;
  int16_t x = 0;
  int16_t y = 0;

  SSD1306_drawPixel(x0, y0 + r, color);
  SSD1306_drawPixel(x0, y0 - r, color);
  SSD1306_drawPixel(x0 + r, y0, color);
  SSD1306_drawPixel(x0 - r, y0, color);

  while (x < y) {
    if (f >= 0) {
      y--;
      ddF_y += 2;
      f += ddF_y;
    }
    x++;
    ddF_x += 2;
    f += ddF_x;

    SSD1306_drawPixel(x0 + x, y0 + y, color);
    SSD1306_drawPixel(x0 - x, y0 + y, color);
    SSD1306_drawPixel(x0 + x, y0 - y, color);
    SSD1306_drawPixel(x0 - x, y0 - y, color);
    SSD1306_drawPixel(x0 + y, y0 + x, color);
    SSD1306_drawPixel(x0 - y, y0 + x, color);
    SSD1306_drawPixel(x0 + y, y0 - x, color);
    SSD1306_drawPixel(x0 - y, y0 - x, color);
  }
}

void move_player(uint16_t x, uint16_t y) {
  uint16_t page = cal_y_to_page(posY);
  if ((x > 770) && (y > 250) && (y < 770))            //  x축 오른쪽으로 움직일 때
  {
    if (gddram[(posX + 5) + page * 128] != 0xff) posX = posX + 8;
  }
  else if ((x < 270) && (y > 250) && (y < 770)) // x축 왼쪽으로 움직일 때
  {
    if (gddram[(posX - 5) + page * 128] != 0xff) posX = posX - 8;
  }
  else if ((y > 770) && (x > 250) && (x < 770))            // y축 위쪽으로 움직일 때
  {
    if (gddram[posX + (page - 1) * 128] != 0xff) posY = posY - 8;
  }
  else if ((y < 270) && (x > 250) && (x < 770))       // y축 아래쪽으로 움직일 때
  {
    if (gddram[posX + (page + 1) * 128] != 0xff) posY = posY + 8;
  }
}

bool sw_count(void) {
  int count = 0;
  for (int d = 0; d < 40; d++) { //초기화면에서 미로로 넘어가기를 기다리는 스위치
    if (get_value_sw() == 0) {
      count++;
      __delay_us(50);
    }
  }
  if (count == 0) return true;
  else return false;
}



void get_moving() {
  char buf[5];
  int rd, rt;
  MUXPOS = 0x00; //AIN0
  rd = get_value();
  inX = x_i_to_str(rd, buf);

  MUXPOS = 0x01; //AIN1
  rd = get_value();
  inY = y_i_to_str(rd, buf);
}
int cal_y_to_page(uint16_t y) {
  int page;
  if (y >= 0 && y < 8) page = 0;
  else if (y > 8 && y < 16) page = 1;
  else if (y > 16 && y < 24) page = 2;
  else if (y > 24 && y < 32) page = 3;
  else if (y > 32 && y < 40) page = 4;
  else if (y > 40 && y < 48) page = 5;
  else if (y > 48 && y < 54) page = 6;
  else page = 7;
  return page;
}
void newWALL(void) {

  if (newWALL_CNT % 2 == 0) {
    clear_screen_gddram();
    drawBitMap(0, 0, wall_1, 128, 64, 0);
    displayOLEDFlush();
    newWALL_CNT++;
  }
  else {
    clear_screen_gddram();
    drawBitMap(0, 0, wall_2, 128, 64, 0);
    displayOLEDFlush();
    newWALL_CNT++;
    posX = 100;
    posY = 44; //나가는거 테스트하기위해 끝부분으로 이동시켜서 시작함.
  }
  drawCicle(posX, posY, 2, 0);
  displayOLEDFlush();
}
void game_init(void) {

  clear_screen_gddram();
  drawBitMap(0, 0, img_main, 128, 64, 0);
  displayOLEDFlush();
  posX = 4;
  posY = 12;
  for (;;) {
    if (sw_count() == 1) {
      newWALL();
      break;
    }
  }
}
void ssd1306_init(void)
{
  ssd1306_reset();
  ssd1306_set_Mux_ratio(63);
  ssd1306_set_Display_Offset(0);
  ssd1306_cmd(SSD1306_CMD_DISPLAY_START_LINE, 1);
  ssd1306_set_addr_mode(PAGE);
  ssd1306_cmd(SSD1306_SEGREMAP, 1);
  ssd1306_cmd(SSD1306_COMSCANDEC, 1);
  ssd1306_set_Contrast_control(0xCF);
  ssd1306_set_Pre_Charge(0xF1);
  ssd1306_set_VCOM_Detect(0x40);
  ssd1306_cmd(SSD1306_DEACTIVATE_SCROLL, 1);
  ssd1306_cmd(SSD1306_CMD_OUTPUT_RAM_DISPLAY, 1);
  ssd1306_normal_display(true);
  ssd1306_chargepump_enable(true);
  ssd1306_display_on(true);
}




void setup(void) {
  adc_init();
  TWI_init();

  ssd1306_init();
  __delay_us(100);


  clear_screen();
  __delay_us(500);


  game_init();
}
void loop(void) {

  char bufff[20];

  for (;;) {
    uint16_t sumx = 0, sumy = 0;
    exX = posX;
    exY = posY;

    for (int i = 0; i < 5; i++) {
      get_moving();
      //  if (inX == 0) continue;
      sumx += inX;
      sumy += inY;
    }
    inX = sumx / 5;
    inY = sumy / 5;


    move_player(inX, inY);
    drawCicle(exX, exY, 2, 2);

    if (posX == 124 && posY == 52) {
      drawCicle(132, 52, 2, 0);
      displayOLEDFlush();

      __delay_ms(100);
      game_init();
      loop();
    }
    drawCicle(posX, posY, 2, 0);
    displayOLEDFlush();

    if (sw_count() == 1) {
      posX = 4;
      posY = 12; //초기화
      newWALL();

    }
  }
}


int main(void) {
  setup();

  while (1) {
    loop();
  }
}
